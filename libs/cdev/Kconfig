## libs/cdev/Kconfig
```kconfig
#
# For a description of the syntax of this configuration file,
# see the file kconfig-language.txt in the NuttX tools repository.
#

comment "CDev Support"

config CDEV
	bool "config cdev support"
	default n
	---help---
		Use cdev 
```

## libs/uorb/Kconfig
```kconfig
#
# For a description of the syntax of this configuration file,
# see the file kconfig-language.txt in the NuttX tools repository.
#

comment "uORB Support"

config UORB
	bool "config uORB support"
	default n
	---help---
		Use uORB
```
